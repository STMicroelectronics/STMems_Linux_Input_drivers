## drivers/input/misc/st/magnetometer/Kconfig
```kconfig
menuconfig INPUT_MAGN
	tristate "magnetometer"

if INPUT_MAGN

source "drivers/input/misc/st/magnetometer/lis3mdl/Kconfig"
source "drivers/input/misc/st/magnetometer/lis2mdl/Kconfig"

endif # INPUT_MAGN
```

## drivers/input/misc/st/magnetometer/lis2mdl/Kconfig
```kconfig
config INPUT_LIS2MDL
         tristate "STM LIS2MDL sensor"
         depends on (I2C || SPI) && SYSFS
	 select INPUT_LIS2MDL_I2C if (I2C)
	 select INPUT_LIS2MDL_SPI if (SPI)
         help
           This driver support the STMicroelectronics LIS2MDL sensor.

config INPUT_LIS2MDL_I2C
         tristate
         depends on INPUT_LIS2MDL
         depends on I2C

config INPUT_LIS2MDL_SPI
         tristate
         depends on INPUT_LIS2MDL
         depends on SPI
```

## drivers/input/misc/st/magnetometer/lis3mdl/Kconfig
```kconfig
config INPUT_LIS3MDL
         tristate "STM LIS3MDL sensor"
         depends on (I2C || SPI) && SYSFS
	 select INPUT_LIS3MDL_I2C if (I2C)
	 select INPUT_LIS3MDL_SPI if (SPI)
         help
           This driver support the STMicroelectronics LIS3MDL sensor.

	   To compile this driver as a module, choose M here. The module
	   will be called lis3mdl.

config INPUT_LIS3MDL_I2C
         tristate
         depends on INPUT_LIS3MDL
         depends on I2C

config INPUT_LIS3MDL_SPI
         tristate
         depends on INPUT_LIS3MDL
         depends on SPI
```

## drivers/input/misc/st/pressure/Kconfig
```kconfig
menuconfig INPUT_PRESSURE
	tristate "Pressure"

if INPUT_PRESSURE

source "drivers/input/misc/st/pressure/lps22hb/Kconfig"
source "drivers/input/misc/st/pressure/lps25h/Kconfig"
source "drivers/input/misc/st/pressure/lps33hw/Kconfig"
source "drivers/input/misc/st/pressure/lps22hh/Kconfig"
source "drivers/input/misc/st/pressure/lps22df/Kconfig"

endif # INPUT_PRESSURE
```

## drivers/input/misc/st/pressure/lps22df/Kconfig
```kconfig
config INPUT_LPS22DF
	tristate "STMicroelectronics LPS22DF sensor"
	depends on (I2C || SPI) && SYSFS
	select INPUT_LPS22DF_I2C if (I2C)
	select INPUT_LPS22DF_SPI if (SPI)
	help
	   Say yes here to build support for STMicroelectronics pressure:
	   LPS22DF.

	   To compile this driver as a module, choose M here. The module
	   will be called lps22df.

config INPUT_LPS22DF_I2C
	tristate
	depends on INPUT_LPS22DF
	depends on I2C

config INPUT_LPS22DF_SPI
	tristate
	depends on INPUT_LPS22DF
	depends on SPI
```

## drivers/input/misc/st/pressure/lps22hb/Kconfig
```kconfig
config INPUT_LPS22HB
	tristate "STMicroelectronics LPS22HB sensor"
	depends on (I2C || SPI) && SYSFS
	select INPUT_LPS22HB_I2C if (I2C)
	select INPUT_LPS22HB_SPI if (SPI)
	help
	   This driver support the STMicroelectronics LPS22HB sensor.

	   To compile this driver as a module, choose M here. The module
	   will be called lps22hb.

config INPUT_LPS22HB_I2C
	tristate
	depends on INPUT_LPS22HB
	depends on I2C

config INPUT_LPS22HB_SPI
	tristate
	depends on INPUT_LPS22HB
	depends on SPI
```

## drivers/input/misc/st/pressure/lps22hh/Kconfig
```kconfig
config INPUT_LPS22HH
	tristate "STMicroelectronics LPS22HH/LPS22CH/LPS27HHW/LPS27HHTW sensor"
	depends on (I2C || SPI) && SYSFS
	select INPUT_LPS22HH_I2C if (I2C)
	select INPUT_LPS22HH_SPI if (SPI)
	help
	   This driver support the STMicroelectronics LPS22HH, LPS22CH,
	   LPS27HHW, LPS27HHTW sensors.

	   To compile this driver as a module, choose M here. The module
	   will be called lps22hh.

config INPUT_LPS22HH_I2C
	tristate
	depends on INPUT_LPS22HH
	depends on I2C

config INPUT_LPS22HH_SPI
	tristate
	depends on INPUT_LPS22HH
	depends on SPI
```

## drivers/input/misc/st/pressure/lps25h/Kconfig
```kconfig
config INPUT_LPS25H
	tristate "STMicroelectronics LPS25H sensor"
	depends on (I2C || SPI) && SYSFS
	select INPUT_LPS25H_I2C if (I2C)
	select INPUT_LPS25H_SPI if (SPI)
	help
	   This driver support the STMicroelectronics LPS25H sensor.

	   To compile this driver as a module, choose M here. The module
	   will be called lps25h.

config INPUT_LPS25H_I2C
	tristate
	depends on INPUT_LPS25H
	depends on I2C

config INPUT_LPS25H_SPI
	tristate
	depends on INPUT_LPS25H
	depends on SPI
```

## drivers/input/misc/st/pressure/lps33hw/Kconfig
```kconfig
config INPUT_LPS33HW
	tristate "STMicroelectronics LPS33HW/LPS35HW sensor"
	depends on (I2C || SPI) && SYSFS
	select INPUT_LPS33HW_I2C if (I2C)
	select INPUT_LPS33HW_SPI if (SPI)
	help
	   Say yes here to build support for STMicroelectronics pressure:
	   LPS33HW, LPS35HW.

	   To compile this driver as a module, choose M here. The module
	   will be called lps33hw.

config INPUT_LPS33HW_I2C
	tristate
	depends on INPUT_LPS33HW
	depends on I2C

config INPUT_LPS33HW_SPI
	tristate
	depends on INPUT_LPS33HW
	depends on SPI
```

## drivers/input/misc/st/temperature/Kconfig
```kconfig
menuconfig INPUT_TEMPERATURE
	tristate "Temperature"

if INPUT_TEMPERATURE

source "drivers/input/misc/st/temperature/stts751/Kconfig"
source "drivers/input/misc/st/temperature/stts22h/Kconfig"

endif # INPUT_TEMPERATURE
```

## drivers/input/misc/st/temperature/stts22h/Kconfig
```kconfig
config INPUT_STTS22H
         tristate "STM STTS22H sensor"
         depends on I2C && SYSFS
         help
           This driver support the STMicroelectronics STTS22H temperature sensor.

	   To compile this driver as a module, choose M here. The module
	   will be called stts22h.
```

## drivers/input/misc/st/temperature/stts751/Kconfig
```kconfig
config INPUT_STTS751
         tristate "STM STTS751 sensor"
         depends on I2C && SYSFS
         help
           This driver support the STMicroelectronics STTS751 sensor.

	   To compile this driver as a module, choose M here. The module
	   will be called stts751.
```

## drivers/input/misc/st/uv/Kconfig
```kconfig
menuconfig INPUT_UV
	tristate "Ultraviolet"

if INPUT_UV

source "drivers/input/misc/st/uv/uvis25/Kconfig"

endif # INPUT_UV
```

## drivers/input/misc/st/uv/uvis25/Kconfig
```kconfig
config INPUT_UVIS25
	tristate "STMicroelectronics UVIS25 sensor"
	depends on (I2C || SPI) && SYSFS
	select INPUT_UVIS25_I2C if (I2C)
	select INPUT_UVIS25_SPI if (SPI)
	help
	   This driver support the STMicroelectronics UVIS25 sensor.

	   To compile this driver as a module, choose M here. The module
	   will be called uvis25.

config INPUT_UVIS25_I2C
	tristate
	depends on INPUT_UVIS25
	depends on I2C

config INPUT_UVIS25_SPI
	tristate
	depends on INPUT_UVIS25
	depends on SPI
```
