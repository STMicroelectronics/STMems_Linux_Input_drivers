## drivers/input/misc/st/ecompass/lsm303ah/Kconfig
```kconfig
config INPUT_LSM303AH
         tristate "STM LSM303AH sensor"
         depends on (I2C || SPI) && SYSFS
	 select INPUT_LSM303AH_I2C if (I2C)
	 select INPUT_LSM303AH_SPI if (SPI)
         help
           This driver support the STMicroelectronics LSM303AH sensor.

config INPUT_LSM303AH_I2C
         tristate
         depends on INPUT_LSM303AH
         depends on I2C

config INPUT_LSM303AH_SPI
         tristate
         depends on INPUT_LSM303AH
         depends on SPI
```

## drivers/input/misc/st/ecompass/lsm303c/Kconfig
```kconfig
config INPUT_LSM303C
         tristate "STM LSM303C sensor"
         depends on (I2C || SPI) && SYSFS
	 select INPUT_LSM303C_I2C if (I2C)
	 select INPUT_LSM303C_SPI if (SPI)
         help
           This driver support the STMicroelectronics LSM303C sensor.

	   To compile this driver as a module, choose M here. The module
	   will be called lsm303c.

config INPUT_LSM303C_I2C
         tristate
         depends on INPUT_LSM303C
         depends on I2C

config INPUT_LSM303C_SPI
         tristate
         depends on INPUT_LSM303C
         depends on SPI
```

## drivers/input/misc/st/ecompass/lsm303d/Kconfig
```kconfig
config INPUT_LSM303D
         tristate "STM LSM303D sensor"
         depends on (I2C || SPI) && SYSFS
	 select INPUT_LSM303D_I2C if (I2C)
	 select INPUT_LSM303D_SPI if (SPI)
         help
           This driver support the STMicroelectronics LSM303D sensor.

	   To compile this driver as a module, choose M here. The module
	   will be called lsm303d.

config INPUT_LSM303D_I2C
         tristate
         depends on INPUT_LSM303D
         depends on I2C

config INPUT_LSM303D_SPI
         tristate
         depends on INPUT_LSM303D
         depends on SPI
```

## drivers/input/misc/st/ecompass/lsm303dlhc/Kconfig
```kconfig
config INPUT_LSM303DLHC
         tristate "STM LSM303DLHC sensor"
         depends on (I2C || SPI) && SYSFS
	 select INPUT_LSM303DLHC_I2C if (I2C)
         help
           This driver support the STMicroelectronics LSM303DLHC sensor.

	   To compile this driver as a module, choose M here. The module
	   will be called lsm303dlhc.

config INPUT_LSM303DLHC_I2C
         tristate
         depends on INPUT_LSM303DLHC
         depends on I2C
```

## drivers/input/misc/st/gyro/Kconfig
```kconfig
menuconfig INPUT_GYRO
	tristate "Gyroscope"

if INPUT_GYRO

source "drivers/input/misc/st/gyro/l3g4200d/Kconfig"
source "drivers/input/misc/st/gyro/l3gd20/Kconfig"
source "drivers/input/misc/st/gyro/l3gd20h/Kconfig"
source "drivers/input/misc/st/gyro/a3g4250d/Kconfig"

endif # INPUT_GYRO
```

## drivers/input/misc/st/gyro/a3g4250d/Kconfig
```kconfig
config INPUT_A3G4250D
	tristate "STMicroelectronics A3G4250D sensor"
	depends on (I2C || SPI) && SYSFS
	select INPUT_A3G4250D_I2C if (I2C)
	select INPUT_A3G4250D_SPI if (SPI)
	select INPUT_POLLDEV
	help
	   This driver support the STMicroelectronics A3G4250D sensor.

	   To compile this driver as a module, choose M here. The module
	   will be called a3g4250d.

config INPUT_A3G4250D_I2C
	tristate
	depends on INPUT_A3G4250D
	depends on I2C

config INPUT_A3G4250D_SPI
	tristate
	depends on INPUT_A3G4250D
	depends on SPI
```

## drivers/input/misc/st/gyro/l3g4200d/Kconfig
```kconfig
config INPUT_L3G4200D
	tristate "STMicroelectronics L3G4200D sensor"
	depends on (I2C || SPI) && SYSFS
	select INPUT_L3G4200D_I2C if (I2C)
	select INPUT_L3G4200D_SPI if (SPI)
	select INPUT_POLLDEV
	help
	   This driver support the STMicroelectronics L3G4200D sensor.

	   To compile this driver as a module, choose M here. The module
	   will be called l3g4200d.

config INPUT_L3G4200D_I2C
	tristate
	depends on INPUT_L3G4200D
	depends on I2C

config INPUT_L3G4200D_SPI
	tristate
	depends on INPUT_L3G4200D
	depends on SPI
```

## drivers/input/misc/st/gyro/l3gd20/Kconfig
```kconfig
config INPUT_L3GD20
         tristate "STMicroelectronics L3GD20 sensor"
         depends on (I2C || SPI) && SYSFS
	 select INPUT_L3GD20_I2C if (I2C)
	 select INPUT_L3GD20_SPI if (SPI)
         help
           This driver support the STMicroelectronics L3GD20 sensor.

	   To compile this driver as a module, choose M here. The module
	   will be called l3gd20.

config INPUT_L3GD20_I2C
         tristate
         depends on INPUT_L3GD20
         depends on I2C

config INPUT_L3GD20_SPI
         tristate
         depends on INPUT_L3GD20
         depends on SPI
```

## drivers/input/misc/st/gyro/l3gd20h/Kconfig
```kconfig
config INPUT_L3GD20H
         tristate "STMicroelectronics L3GD20H sensor"
         depends on (I2C || SPI) && SYSFS
	 select INPUT_L3GD20H_I2C if (I2C)
	 select INPUT_L3GD20H_SPI if (SPI)
         help
           This driver support the STMicroelectronics L3GD20H sensor.

	   To compile this driver as a module, choose M here. The module
	   will be called l3gd20h.

config INPUT_L3GD20H_I2C
         tristate
         depends on INPUT_L3GD20H
         depends on I2C

config INPUT_L3GD20H_SPI
         tristate
         depends on INPUT_L3GD20H
         depends on SPI
```

## drivers/input/misc/st/humidity/Kconfig
```kconfig
menuconfig INPUT_HUMIDITY
	tristate "Humidity"

if INPUT_HUMIDITY

source "drivers/input/misc/st/humidity/hts221/Kconfig"

endif # INPUT_HUMIDITY
```

## drivers/input/misc/st/humidity/hts221/Kconfig
```kconfig
config INPUT_HTS221
         tristate "STM HTS221 sensor"
         depends on (I2C || SPI) && SYSFS
	 select INPUT_HTS221_I2C if (I2C)
	 select INPUT_HTS221_SPI if (SPI)
         help
           This driver support the STMicroelectronics HTS221 sensor.

	   To compile this driver as a module, choose M here. The module
	   will be called hts221.

config INPUT_HTS221_I2C
         tristate
         depends on INPUT_HTS221
         depends on I2C

config INPUT_HTS221_SPI
         tristate
         depends on INPUT_HTS221
         depends on SPI
```

## drivers/input/misc/st/imu/Kconfig
```kconfig
menuconfig INPUT_IMU
	tristate "Inertial motion unit"

if INPUT_IMU

source "drivers/input/misc/st/imu/lsm6ds3/Kconfig"
source "drivers/input/misc/st/imu/lsm6dsm/Kconfig"
source "drivers/input/misc/st/imu/lsm6dsl/Kconfig"
source "drivers/input/misc/st/imu/lsm9ds0/Kconfig"
source "drivers/input/misc/st/imu/lsm9ds1/Kconfig"
source "drivers/input/misc/st/imu/lsm330dlc/Kconfig"
source "drivers/input/misc/st/imu/lsm6ds0/Kconfig"
source "drivers/input/misc/st/imu/lsm330/Kconfig"
source "drivers/input/misc/st/imu/ism330dlc/Kconfig"
source "drivers/input/misc/st/imu/asm330lhh/Kconfig"

endif # INPUT_IMU
```

## drivers/input/misc/st/imu/asm330lhh/Kconfig
```kconfig
config INPUT_ASM330LHH
	tristate "STMicroelectronics ASM330LHH sensor"
	depends on (I2C || SPI) && SYSFS
	select INPUT_ASM330LHH_I2C if (I2C)
	select INPUT_ASM330LHH_SPI if (SPI)
	help
	   This driver support the STMicroelectronics ASM330LHH sensor.

	   To compile this driver as a module, choose M here. The module
	   will be called asm330lhh.

config INPUT_ASM330LHH_I2C
	tristate
	depends on INPUT_ASM330LHH
	depends on I2C

config INPUT_ASM330LHH_SPI
	tristate
	depends on INPUT_ASM330LHH
	depends on SPI

config ASM330LHH_IRQ_THREAD
	bool "Enable support to data ready irq"
	depends on INPUT_ASM330LHH
	help
		Enable irq management on INT_1/INT_2
```

## drivers/input/misc/st/imu/asm330lxh/Kconfig
```kconfig
config INPUT_ASM330LXH
	tristate "STMicroelectronics ASM330LXH sensor"
	depends on (I2C || SPI) && SYSFS
	select INPUT_ASM330LXH_I2C if (I2C)
	select INPUT_ASM330LXH_SPI if (SPI)
	help
	   This driver support the STMicroelectronics ASM330LXH sensor.

	   To compile this driver as a module, choose M here. The module
	   will be called asm330lxh.

config INPUT_ASM330LXH_I2C
	tristate
	depends on INPUT_ASM330LXH
	depends on I2C

config INPUT_ASM330LXH_SPI
	tristate
	depends on INPUT_ASM330LXH
	depends on SPI
```

## drivers/input/misc/st/imu/ism330dlc/Kconfig
```kconfig
config INPUT_ISM330DLC
	tristate "STMicroelectronics ISM330DLC sensor"
	depends on (I2C || SPI) && SYSFS
	select INPUT_ISM330DLC_I2C if (I2C)
	select INPUT_ISM330DLC_SPI if (SPI)
	help
	   This driver support the STMicroelectronics ISM330DLC sensor.

	   To compile this driver as a module, choose M here. The module
	   will be called ism330dlc.

config INPUT_ISM330DLC_I2C
	tristate
	depends on INPUT_ISM330DLC
	depends on I2C

config INPUT_ISM330DLC_SPI
	tristate
	depends on INPUT_ISM330DLC
	depends on SPI
```

## drivers/input/misc/st/imu/lsm330/Kconfig
```kconfig
config INPUT_LSM330
	tristate "STMicroelectronics LSM330 sensor"
	depends on (I2C || SPI) && SYSFS
	select INPUT_LSM330_I2C if (I2C)
	select INPUT_LSM330_SPI if (SPI)
	help
	   This driver support the STMicroelectronics LSM330 sensor.

	   To compile this driver as a module, choose M here. The module
	   will be called lsm330.

config INPUT_LSM330_I2C
	tristate
	depends on INPUT_LSM330
	depends on I2C

config INPUT_LSM330_SPI
	tristate
	depends on INPUT_LSM330
	depends on SPI
```

## drivers/input/misc/st/imu/lsm330dlc/Kconfig
```kconfig
config INPUT_LSM330DLC
	tristate "STMicroelectronics LSM330DLC sensor"
	depends on (I2C || SPI) && SYSFS
	select INPUT_LSM330DLC_I2C if (I2C)
	select INPUT_LSM330DLC_SPI if (SPI)
	help
	   This driver support the STMicroelectronics LSM330DLC sensor.

	   To compile this driver as a module, choose M here. The module
	   will be called lsm330dlc.

config INPUT_LSM330DLC_I2C
	tristate
	depends on INPUT_LSM330DLC
	depends on I2C

config INPUT_LSM330DLC_SPI
	tristate
	depends on INPUT_LSM330DLC
	depends on SPI
```

## drivers/input/misc/st/imu/lsm6dl0/Kconfig
```kconfig
config INPUT_LSM6DL0
	tristate "STMicroelectronics LSM6DL0 sensor"
	depends on (I2C || SPI) && SYSFS
	select INPUT_LSM6DL0_I2C if (I2C)
	select INPUT_LSM6DL0_SPI if (SPI)
	help
	   This driver support the STMicroelectronics LSM6DL0 sensor.

	   To compile this driver as a module, choose M here. The module
	   will be called lsm6dl0.

config INPUT_LSM6DL0_I2C
	tristate
	depends on INPUT_LSM6DL0
	depends on I2C

config INPUT_LSM6DL0_SPI
	tristate
	depends on INPUT_LSM6DL0
	depends on SPI
```

## drivers/input/misc/st/imu/lsm6ds0/Kconfig
```kconfig
config INPUT_LSM6DS0
	tristate "STMicroelectronics LSM6DS0 sensor"
	depends on (I2C || SPI) && SYSFS
	select INPUT_LSM6DS0_I2C if (I2C)
	select INPUT_LSM6DS0_SPI if (SPI)
	help
	   This driver support the STMicroelectronics LSM6DS0 sensor.

	   To compile this driver as a module, choose M here. The module
	   will be called lsm6ds0.

config INPUT_LSM6DS0_I2C
	tristate
	depends on INPUT_LSM6DS0
	depends on I2C

config INPUT_LSM6DS0_SPI
	tristate
	depends on INPUT_LSM6DS0
	depends on SPI
```

## drivers/input/misc/st/imu/lsm6ds3/Kconfig
```kconfig
config INPUT_LSM6DS3
	tristate "STMicroelectronics LSM6DS3/LSM6DS3H sensor"
	depends on (I2C || SPI) && SYSFS
	select INPUT_LSM6DS3_I2C if (I2C)
	select INPUT_LSM6DS3_SPI if (SPI)
	help
	   This driver support the STMicroelectronics LSM6DS3 sensor.

	   To compile this driver as a module, choose M here. The module
	   will be called lsm6ds3.

config INPUT_LSM6DS3_I2C
	tristate
	depends on INPUT_LSM6DS3
	depends on I2C

config INPUT_LSM6DS3_SPI
	tristate
	depends on INPUT_LSM6DS3
	depends on SPI
```

## drivers/input/misc/st/imu/lsm6dsl/Kconfig
```kconfig
config INPUT_LSM6DSL
	tristate "STMicroelectronics LSM6DSL sensor"
	depends on (I2C || SPI) && SYSFS
	select INPUT_LSM6DSL_I2C if (I2C)
	select INPUT_LSM6DSL_SPI if (SPI)
	help
	   This driver support the STMicroelectronics LSM6DSL sensor.

	   To compile this driver as a module, choose M here. The module
	   will be called lsm6dsl.

config INPUT_LSM6DSL_I2C
	tristate
	depends on INPUT_LSM6DSL
	depends on I2C

config INPUT_LSM6DSL_SPI
	tristate
	depends on INPUT_LSM6DSL
	depends on SPI
```

## drivers/input/misc/st/imu/lsm6dsm/Kconfig
```kconfig
config INPUT_LSM6DSM
	tristate "STMicroelectronics LSM6DSM sensor"
	depends on (I2C || SPI) && SYSFS
	select INPUT_LSM6DSM_I2C if (I2C)
	select INPUT_LSM6DSM_SPI if (SPI)
	help
	   This driver support the STMicroelectronics LSM6DSM sensor.

	   To compile this driver as a module, choose M here. The module
	   will be called lsm6dsm.

config INPUT_LSM6DSM_I2C
	tristate
	depends on INPUT_LSM6DSM
	depends on I2C

config INPUT_LSM6DSM_SPI
	tristate
	depends on INPUT_LSM6DSM
	depends on SPI
```

## drivers/input/misc/st/imu/lsm6dsox/Kconfig
```kconfig
config INPUT_LSM6DSOX
	tristate "STMicroelectronics LSM6DSOX sensor"
	depends on (I2C || SPI) && SYSFS
	select INPUT_LSM6DSOX_I2C if (I2C)
	select INPUT_LSM6DSOX_SPI if (SPI)
	help
	   This driver support the STMicroelectronics LSM6DSOX sensor.

	   To compile this driver as a module, choose M here. The module
	   will be called lsm6dsox.

config INPUT_LSM6DSOX_I2C
	tristate
	depends on INPUT_LSM6DSOX
	depends on I2C

config INPUT_LSM6DSOX_SPI
	tristate
	depends on INPUT_LSM6DSOX
	depends on SPI
```

## drivers/input/misc/st/imu/lsm9ds0/Kconfig
```kconfig
config INPUT_LSM9DS0
	tristate "STMicroelectronics LSM9DS0 sensor"
	depends on (I2C || SPI) && SYSFS
	select INPUT_LSM9DS0_I2C if (I2C)
	select INPUT_LSM9DS0_SPI if (SPI)
	help
	   This driver support the STMicroelectronics LSM9DS0 sensor.

	   To compile this driver as a module, choose M here. The module
	   will be called lsm9ds0.

config INPUT_LSM9DS0_I2C
	tristate
	depends on INPUT_LSM9DS0
	depends on I2C

config INPUT_LSM9DS0_SPI
	tristate
	depends on INPUT_LSM9DS0
	depends on SPI
```

## drivers/input/misc/st/imu/lsm9ds1/Kconfig
```kconfig
config INPUT_LSM9DS1
	tristate "STMicroelectronics LSM9DS1 sensor"
	depends on (I2C || SPI) && SYSFS
	select INPUT_LSM9DS1_I2C if (I2C)
	select INPUT_LSM9DS1_SPI if (SPI)
	help
	   This driver support the STMicroelectronics LSM9DS1 sensor.

	   To compile this driver as a module, choose M here. The module
	   will be called lsm9ds1.

config INPUT_LSM9DS1_I2C
	tristate
	depends on INPUT_LSM9DS1
	depends on I2C

config INPUT_LSM9DS1_SPI
	tristate
	depends on INPUT_LSM9DS1
	depends on SPI
```
