## Documentation/devicetree/bindings/input/st-asm330lhh.txt
```
* asm330lhh driver for imu MEMS sensors

Required properties for all bus drivers:
- compatible: must be one of:
              "st,asm330lhh"
              "st,lsm6dsr"
              "st,ism330dhcx"

Optional properties for all bus drivers (more details reported in
Documentation/devicetree/bindings/interrupt-controller/interrupts.txt):
- interrupt-parent = This property is used to specify the controller to
                     which interrupts are routed.
- interrupts =       Interrupts listed here are always in reference to
                     the node's interrupt-parent.

Required properties for the i2c bindings:
- reg: i2c slave address

Required properties for the spi bindings:
- reg:               the chipselect index
- spi-max-frequency: maximal bus speed, should be set to 1000000 unless
                     constrained by external circuitry

Example for an spi device node:

asm330lhh-imu@0 {
	compatible = "st,asm330lhh";
	reg = <0x0>;
	spi-max-frequency = <1000000>;
};

Example for an i2c device node with pull down on SD0:

asm330lhh-imu@6a {
	compatible = "st,asm330lhh";
	reg = <0x6a>;
};

Example for an i2c device node with pull up on SD0:

asm330lhh-imu@6b {
	compatible = "st,asm330lhh";
	reg = <0x6b>;
};
```

## Documentation/devicetree/bindings/input/st-lis2mdl.txt
```
/* STMicroelectronics lis2mdl magnetometer sensor */

Required properties:
	- compatible : should be "st,lis2mdl"
	- reg : the I2C address of the sensor


Example:

lis2mdl@1e {
	compatible = "st,lis2mdl";
	reg = <0x1e>;
};
```

## Documentation/devicetree/bindings/input/st-lsm6dsox.txt
```
* lsm6dsox driver for imu MEMS sensors

Required properties for all bus drivers:
- compatible: must be one of:
              "st,lsm6dso"
              "st,lsm6dsox"
              "st,lsm6dso32"
              "st,lsm6dso32x"

Optional properties for all bus drivers:
- st,drdy-int-pin: must be one of:
              <1> - Route Tilt/Step_D/Step_C/Sign_M events interrupt on int pin 1
	      <2> - Route Tilt/Step_D/Step_C/Sign_M events interrupt on int pin 2
  if not defined default value is int pin 1

Required properties for the i2c bindings:
- reg: i2c slave address

Required properties for the spi bindings:
- reg:               the chipselect index
- spi-max-frequency: maximal bus speed, should be set to 1000000 unless
                     constrained by external circuitry

Example for an spi device node:

lsm6dsox-imu@0 {
	compatible = "st,lsm6dsox";
	reg = <0x0>;
	spi-max-frequency = <1000000>;
};

Example for an i2c device node with pull down on SD0:

lsm6dsox-imu@6a {
	compatible = "st,lsm6dsox";
	st,drdy-int-pin = <1>;
	reg = <0x6a>;
};

Example for an i2c device node with pull up on SD0:

lsm6dsox-imu@6b {
	compatible = "st,lsm6dsox";
	st,drdy-int-pin = <1>;
	reg = <0x6b>;
};
```

## Documentation/devicetree/bindings/input/st-stts22h.txt
```
* stts22h driver for temperature MEMS sensors

Required properties:
	- compatible : should be "st,stts22h"
	- reg : the I2C address of the sensor

Example for an i2c device node with pull down on SD0:

stts22h-temp@38 {
	compatible = "st,stts22h";
	reg = <0x38>;
};

Example for an i2c device node with pull up on SD0:

stts22h-temp@3f {
	compatible = "st,stts22h";
	reg = <0x3f>;
};
```

## drivers/input/misc/st/Kconfig
```kconfig
menuconfig INPUT_ST
	tristate "STM MEMs Device Drivers"

if INPUT_ST

source "drivers/input/misc/st/imu/Kconfig"
source "drivers/input/misc/st/ecompass/Kconfig"
source "drivers/input/misc/st/acc/Kconfig"
source "drivers/input/misc/st/humidity/Kconfig"
source "drivers/input/misc/st/gyro/Kconfig"
source "drivers/input/misc/st/magnetometer/Kconfig"
source "drivers/input/misc/st/pressure/Kconfig"
source "drivers/input/misc/st/uv/Kconfig"

endif # INPUT_ST
```

## drivers/input/misc/st/acc/Kconfig
```kconfig
menuconfig INPUT_ACC
	tristate "accelerometer"

if INPUT_ACC

source "drivers/input/misc/st/acc/ais328dq/Kconfig"
source "drivers/input/misc/st/acc/ais3624dq/Kconfig"
source "drivers/input/misc/st/acc/lis2dh/Kconfig"
source "drivers/input/misc/st/acc/lis2de/Kconfig"
source "drivers/input/misc/st/acc/lis2ds/Kconfig"
source "drivers/input/misc/st/acc/h3lis100dl/Kconfig"
source "drivers/input/misc/st/acc/lis3dsh/Kconfig"
source "drivers/input/misc/st/acc/lis2hh12/Kconfig"
source "drivers/input/misc/st/acc/lis3de/Kconfig"
source "drivers/input/misc/st/acc/lis331dlh/Kconfig"
source "drivers/input/misc/st/acc/lis331hh/Kconfig"
source "drivers/input/misc/st/acc/h3lis331dl/Kconfig"
source "drivers/input/misc/st/acc/lis3dh/Kconfig"
source "drivers/input/misc/st/acc/lis2dw12/Kconfig"

endif # INPUT_ACC
```

## drivers/input/misc/st/acc/ais328dq/Kconfig
```kconfig
config INPUT_AIS328DQ
	tristate "STMicroelectronics AIS328DQ sensor"
	depends on (I2C || SPI) && SYSFS
	select INPUT_AIS328DQ_I2C if (I2C)
	select INPUT_AIS328DQ_SPI if (SPI)
	help
	   This driver support the STMicroelectronics AIS328DQ sensor.

	   To compile this driver as a module, choose M here. The module
	   will be called ais328dq.

config INPUT_AIS328DQ_I2C
	tristate
	depends on INPUT_AIS328DQ
	depends on I2C

config INPUT_AIS328DQ_SPI
	tristate
	depends on INPUT_AIS328DQ
	depends on SPI
```

## drivers/input/misc/st/acc/ais3624dq/Kconfig
```kconfig
config INPUT_AIS3624DQ
	tristate "STMicroelectronics AIS3624DQ sensor"
	depends on (I2C || SPI) && SYSFS
	select INPUT_AIS3624DQ_I2C if (I2C)
	select INPUT_AIS3624DQ_SPI if (SPI)
	help
	   This driver support the STMicroelectronics AIS3624DQ sensor.

	   To compile this driver as a module, choose M here. The module
	   will be called ais3624dq.

config INPUT_AIS3624DQ_I2C
	tristate
	depends on INPUT_AIS3624DQ
	depends on I2C

config INPUT_AIS3624DQ_SPI
	tristate
	depends on INPUT_AIS3624DQ
	depends on SPI
```

## drivers/input/misc/st/acc/h3lis100dl/Kconfig
```kconfig
config INPUT_H3LIS100DL
	tristate "STMicroelectronics H3LIS100DL sensor"
	depends on (I2C || SPI) && SYSFS
	select INPUT_H3LIS100DL_I2C if (I2C)
	select INPUT_H3LIS100DL_SPI if (SPI)
	help
	   This driver support the STMicroelectronics H3LIS100DL sensor.

	   To compile this driver as a module, choose M here. The module
	   will be called h3lis100dl.

config INPUT_H3LIS100DL_I2C
	tristate
	depends on INPUT_H3LIS100DL
	depends on I2C

config INPUT_H3LIS100DL_SPI
	tristate
	depends on INPUT_H3LIS100DL
	depends on SPI
```

## drivers/input/misc/st/acc/h3lis331dl/Kconfig
```kconfig
config INPUT_H3LIS331DL
	tristate "STMicroelectronics H3LIS331DL sensor"
	depends on (I2C || SPI) && SYSFS
	select INPUT_H3LIS331DL_I2C if (I2C)
	select INPUT_H3LIS331DL_SPI if (SPI)
	help
	   This driver support the STMicroelectronics H3LIS331DL sensor.

	   To compile this driver as a module, choose M here. The module
	   will be called h3lis331dl.

config INPUT_H3LIS331DL_I2C
	tristate
	depends on INPUT_H3LIS331DL
	depends on I2C

config INPUT_H3LIS331DL_SPI
	tristate
	depends on INPUT_H3LIS331DL
	depends on SPI
```

## drivers/input/misc/st/acc/lis2de/Kconfig
```kconfig
config INPUT_LIS2DE
	tristate "STMicroelectronics LIS2DE/LIS2DE12 sensor"
	depends on (I2C || SPI) && SYSFS
	select INPUT_LIS2DE_I2C if (I2C)
	select INPUT_LIS2DE_SPI if (SPI)
	help
	   This driver support the STMicroelectronics LIS2DE/LIS2DE12 sensor.

	   To compile this driver as a module, choose M here. The module
	   will be called lis2de.

config INPUT_LIS2DE_I2C
	tristate
	depends on INPUT_LIS2DE
	depends on I2C

config INPUT_LIS2DE_SPI
	tristate
	depends on INPUT_LIS2DE
	depends on SPI
```

## drivers/input/misc/st/acc/lis2dh/Kconfig
```kconfig
config INPUT_LIS2DH
	tristate "STMicroelectronics LIS2DH/LIS2DH12 sensor"
	depends on (I2C || SPI) && SYSFS
	select INPUT_LIS2DH_I2C if (I2C)
	select INPUT_LIS2DH_SPI if (SPI)
	help
	   This driver support the STMicroelectronics LIS2DH/LIS2DH12 sensor.

	   To compile this driver as a module, choose M here. The module
	   will be called lis2dh.

config INPUT_LIS2DH_I2C
	tristate
	depends on INPUT_LIS2DH
	depends on I2C

config INPUT_LIS2DH_SPI
	tristate
	depends on INPUT_LIS2DH
	depends on SPI
```

## drivers/input/misc/st/acc/lis2ds/Kconfig
```kconfig
config INPUT_LIS2DS
	tristate "STMicroelectronics LIS2DS/LIS2DS12 sensors"
	depends on (I2C || SPI) && SYSFS
	select INPUT_LIS2DS_I2C if (I2C)
	select INPUT_LIS2DS_SPI if (SPI)
	help
	   This driver support the STMicroelectronics LIS2DS/LIS2DS12 sensors.

	   To compile this driver as a module, choose M here. The module
	   will be called lis2ds.

config INPUT_LIS2DS_I2C
	tristate
	depends on INPUT_LIS2DS
	depends on I2C

config INPUT_LIS2DS_SPI
	tristate
	depends on INPUT_LIS2DS
	depends on SPI
```

## drivers/input/misc/st/acc/lis2dw12/Kconfig
```kconfig
config INPUT_LIS2DW12
	tristate "STMicroelectronics LIS2DW12 sensors"
	depends on (I2C || SPI) && SYSFS
	select INPUT_LIS2DW12_I2C if (I2C)
	select INPUT_LIS2DW12_SPI if (SPI)
	help
	   This driver support the STMicroelectronics LIS2DW12 sensors.

	   To compile this driver as a module, choose M here. The module
	   will be called lis2dw12.

config INPUT_LIS2DW12_I2C
	tristate
	depends on INPUT_LIS2DW12
	depends on I2C

config INPUT_LIS2DW12_SPI
	tristate
	depends on INPUT_LIS2DW12
	depends on SPI
```

## drivers/input/misc/st/acc/lis2hh12/Kconfig
```kconfig
config INPUT_LIS2HH12
	tristate "STMicroelectronics LIS2HH12 sensor"
	depends on (I2C || SPI) && SYSFS
	select INPUT_LIS2HH12_I2C if (I2C)
	select INPUT_LIS2HH12_SPI if (SPI)
	help
	   This driver support the STMicroelectronics LIS2HH12 sensor.

	   To compile this driver as a module, choose M here. The module
	   will be called lis2hh12.

config INPUT_LIS2HH12_I2C
	tristate
	depends on INPUT_LIS2HH12
	depends on I2C

config INPUT_LIS2HH12_SPI
	tristate
	depends on INPUT_LIS2HH12
	depends on SPI
```

## drivers/input/misc/st/acc/lis331dlh/Kconfig
```kconfig
config INPUT_LIS331DLH
	tristate "STMicroelectronics LIS331DLH sensor"
	depends on (I2C || SPI) && SYSFS
	select INPUT_LIS331DLH_I2C if (I2C)
	select INPUT_LIS331DLH_SPI if (SPI)
	help
	   This driver support the STMicroelectronics LIS331DLH sensor.

	   To compile this driver as a module, choose M here. The module
	   will be called lis331dlh.

config INPUT_LIS331DLH_I2C
	tristate
	depends on INPUT_LIS331DLH
	depends on I2C

config INPUT_LIS331DLH_SPI
	tristate
	depends on INPUT_LIS331DLH
	depends on SPI
```

## drivers/input/misc/st/acc/lis331hh/Kconfig
```kconfig
config INPUT_LIS331HH
	tristate "STMicroelectronics LIS331HH sensor"
	depends on (I2C || SPI) && SYSFS
	select INPUT_LIS331HH_I2C if (I2C)
	select INPUT_LIS331HH_SPI if (SPI)
	help
	   This driver support the STMicroelectronics LIS331HH sensor.

	   To compile this driver as a module, choose M here. The module
	   will be called lis331hh.

config INPUT_LIS331HH_I2C
	tristate
	depends on INPUT_LIS331HH
	depends on I2C

config INPUT_LIS331HH_SPI
	tristate
	depends on INPUT_LIS331HH
	depends on SPI
```

## drivers/input/misc/st/acc/lis3de/Kconfig
```kconfig
config INPUT_LIS3DE
	tristate "STMicroelectronics LIS3DE sensor"
	depends on (I2C || SPI) && SYSFS
	select INPUT_LIS3DE_I2C if (I2C)
	select INPUT_LIS3DE_SPI if (SPI)
	help
	   This driver support the STMicroelectronics LIS3DE sensor.

	   To compile this driver as a module, choose M here. The module
	   will be called lis3de.

config INPUT_LIS3DE_I2C
	tristate
	depends on INPUT_LIS3DE
	depends on I2C

config INPUT_LIS3DE_SPI
	tristate
	depends on INPUT_LIS3DE
	depends on SPI
```

## drivers/input/misc/st/acc/lis3dh/Kconfig
```kconfig
config INPUT_LIS3DH
	tristate "STMicroelectronics LIS3DH sensor"
	depends on (I2C || SPI) && SYSFS
	select INPUT_LIS3DH_I2C if (I2C)
	select INPUT_LIS3DH_SPI if (SPI)
	help
	   This driver support the STMicroelectronics LIS3DH sensor.

	   To compile this driver as a module, choose M here. The module
	   will be called lis3dh.

config INPUT_LIS3DH_I2C
	tristate
	depends on INPUT_LIS3DH
	depends on I2C

config INPUT_LIS3DH_SPI
	tristate
	depends on INPUT_LIS3DH
	depends on SPI
```

## drivers/input/misc/st/acc/lis3dhh/Kconfig
```kconfig
config INPUT_LIS3DHH
	tristate "STMicroelectronics LIS3DHH sensor"
	depends on SPI && SYSFS
	select INPUT_LIS3DHH_SPI if (SPI)
	help
	   This driver support the STMicroelectronics LIS3DHH sensor.

	   To compile this driver as a module, choose M here. The module
	   will be called lis3dhh.

config INPUT_LIS3DHH_SPI
	tristate
	depends on INPUT_LIS3DHH
	depends on SPI
```

## drivers/input/misc/st/acc/lis3dsh/Kconfig
```kconfig
config INPUT_LIS3DSH
	tristate "STMicroelectronics LIS3DSH sensor"
	depends on (I2C || SPI) && SYSFS
	select INPUT_LIS3DSH_I2C if (I2C)
	select INPUT_LIS3DSH_SPI if (SPI)
	help
	   This driver support the STMicroelectronics LIS3DSH sensor.

	   To compile this driver as a module, choose M here. The module
	   will be called lis3dsh.

config INPUT_LIS3DSH_I2C
	tristate
	depends on INPUT_LIS3DSH
	depends on I2C

config INPUT_LIS3DSH_SPI
	tristate
	depends on INPUT_LIS3DSH
	depends on SPI
```

## drivers/input/misc/st/acc/n2dm/Kconfig
```kconfig
config INPUT_N2DM
	tristate "STMicroelectronics N2DM sensor"
	depends on I2C && SYSFS
	select INPUT_N2DM_I2C if (I2C)
	help
	   This driver support the STMicroelectronics N2DM sensor.

	   To compile this driver as a module, choose M here. The module
	   will be called n2dm.

config INPUT_N2DM_I2C
	tristate
	depends on INPUT_N2DM
	depends on I2C
```

## drivers/input/misc/st/ecompass/Kconfig
```kconfig
menuconfig INPUT_ECOMPASS
	tristate "eCompass"

if INPUT_ECOMPASS

source "drivers/input/misc/st/ecompass/lsm303agr/Kconfig"
source "drivers/input/misc/st/ecompass/lsm303ah/Kconfig"
source "drivers/input/misc/st/ecompass/lsm303c/Kconfig"
source "drivers/input/misc/st/ecompass/lsm303d/Kconfig"
source "drivers/input/misc/st/ecompass/lsm303dlhc/Kconfig"

endif # INPUT_ECOMPASS
```

## drivers/input/misc/st/ecompass/ism303dac/Kconfig
```kconfig
config INPUT_ISM303DAC
         tristate "STM ISM303DAC sensor"
         depends on (I2C || SPI) && SYSFS
	 select INPUT_ISM303DAC_I2C if (I2C)
	 select INPUT_ISM303DAC_SPI if (SPI)
         help
           This driver support the STMicroelectronics ISM303DAC sensor.

config INPUT_ISM303DAC_I2C
         tristate
         depends on INPUT_ISM303DAC
         depends on I2C

config INPUT_ISM303DAC_SPI
         tristate
         depends on INPUT_ISM303DAC
         depends on SPI
```

## drivers/input/misc/st/ecompass/lsm303agr/Kconfig
```kconfig
config INPUT_LSM303AGR
         tristate "STM LSM303AGR sensor"
         depends on (I2C || SPI) && SYSFS
	 select INPUT_LSM303AGR_I2C if (I2C)
	 select INPUT_LSM303AGR_SPI if (SPI)
         help
           This driver support the STMicroelectronics LSM303AGR sensor.

	   To compile this driver as a module, choose M here. The module
	   will be called lsm303agr.

config INPUT_LSM303AGR_I2C
         tristate
         depends on INPUT_LSM303AGR
         depends on I2C

config INPUT_LSM303AGR_SPI
         tristate
         depends on INPUT_LSM303AGR
         depends on SPI
```
